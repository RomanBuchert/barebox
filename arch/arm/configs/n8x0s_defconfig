## arch/arm/configs/n8x0s_defconfig
```kconfig
CONFIG_ARCH_OMAP_MULTI=y
CONFIG_MACH_NOKIA_N800=y
# CONFIG_OMAP_GPMC is not set
CONFIG_ARM_OPTIMZED_STRING_FUNCTIONS=y
CONFIG_NAME="n8x0s"
CONFIG_MMU=y
CONFIG_MALLOC_SIZE=0x0
CONFIG_MALLOC_TLSF=y
CONFIG_KALLSYMS=y
CONFIG_PROMPT="n8x0s> "
CONFIG_CMDLINE_EDITING=y
CONFIG_AUTO_COMPLETE=y
CONFIG_MENU=y
# CONFIG_TIMESTAMP is not set
CONFIG_BOOTM_SHOW_TYPE=y
CONFIG_BOOTM_VERBOSE=y
CONFIG_BOOTM_INITRD=y
CONFIG_BOOTM_OFTREE=y
# CONFIG_CONSOLE_ACTIVATE_FIRST is not set
CONFIG_CONSOLE_ACTIVATE_ALL=y
CONFIG_DEFAULT_ENVIRONMENT_GENERIC_NEW=y
CONFIG_LONGHELP=y
CONFIG_CMD_IOMEM=y
CONFIG_CMD_MEMINFO=y
CONFIG_CMD_ARM_MMUINFO=y
CONFIG_CMD_BOOTZ=y
CONFIG_CMD_GO=y
CONFIG_CMD_RESET=y
CONFIG_CMD_PRINTENV=y
CONFIG_CMD_FILETYPE=y
CONFIG_CMD_ECHO_E=y
CONFIG_CMD_MENU=y
CONFIG_CMD_READLINE=y
CONFIG_CMD_TIMEOUT=y
CONFIG_CMD_OF_NODE=y
CONFIG_CMD_OF_PROPERTY=y
CONFIG_CMD_OFTREE=y
CONFIG_FS_EXT4=y
CONFIG_FS_FAT=y

CONFIG_VIDEO=y
CONFIG_DRIVER_VIDEO_N800_BLIZZARD=y
# CONFIG_FRAMEBUFFER_CONSOLE is not set

CONFIG_MCI=y
CONFIG_MCI_STARTUP=y
CONFIG_MCI_OMAP2420=y
CONFIG_CMD_DEVINFO=y
CONFIG_CMD_LS=y

CONFIG_I2C=y
CONFIG_I2C_CBUS_GPIO=y
CONFIG_MFD_RETU=y
CONFIG_WATCHDOG=y
CONFIG_RETU_WATCHDOG=y

CONFIG_USB_GADGET=y
CONFIG_USB_GADGET_SERIAL=y
CONFIG_USB_MUSB=y
CONFIG_USB_MUSB_GADGET=y
CONFIG_USB_MUSB_TUSB6010=y
# CONFIG_CMD_USBGADGET is not set

CONFIG_CMD_LOADY=y
CONFIG_CMD_N8X0S_BOOTMENU=y
CONFIG_PNG=y
CONFIG_PICOPNG=y

CONFIG_CMD_N8X0S_MIPID_TEST=y
```

## drivers/usb/musb/Kconfig
```kconfig
# SPDX-License-Identifier: GPL-2.0-only
config USB_MUSB
	bool "MUSB support"

if USB_MUSB

config USB_MUSB_DSPS
	tristate
	select OFDEVICE
	select USB_OTGDEV

config USB_MUSB_AM335X
	tristate "AM335x USB support"
	depends on ARCH_AM33XX
	select USB_MUSB_DSPS
	help
	  This driver provides the necessary bit to enable USB support
	  on the TI AM335x SoC.

config USB_MUSB_TUSB6010
	bool "TUSB6010 MUSB support"
	depends on ARCH_OMAP2
	select USB_MUSB_GADGET
	help
	  Enable the TUSB6010 glue needed by the Nokia N800. The initial
	  implementation is peripheral-only and uses PIO through the
	  asynchronous GPMC chip select.

config USB_MUSB_HOST
	bool "MUSB Host mode support"
	depends on USB_HOST
	help
	  Select this when you want to use MUSB in host mode.

config USB_MUSB_GADGET
	bool "MUSB Gadget mode support"
	depends on USB_GADGET
	help
	  Select this when you want to use MUSB in gadget mode.

endif
```
